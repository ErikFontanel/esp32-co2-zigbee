## sdkconfig.defaults
```kconfig
# Zigbee
CONFIG_ZB_ENABLED=y
CONFIG_ZB_RADIO_NATIVE=y
CONFIG_ZB_ZCZR=y

# IEEE 802.15.4
CONFIG_IEEE802154_ENABLED=y

# Partition table
CONFIG_PARTITION_TABLE_CUSTOM=y
CONFIG_PARTITION_TABLE_CUSTOM_FILENAME="zigbee.csv"

# Flash
CONFIG_ESPTOOLPY_FLASHSIZE_4MB=y

# Stack
CONFIG_ESP_MAIN_TASK_STACK_SIZE=4096
```
