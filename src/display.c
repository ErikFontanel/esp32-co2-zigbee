// SSD1306 128x64 I2C OLED — runtime-detected, no-op when absent

#include "display.h"
#include "esp_log.h"
#include <string.h>
#include <stdio.h>

#define SSD1306_ADDR  0x3C
#define SSD1306_W     128
#define SSD1306_H     32
#define SSD1306_PAGES (SSD1306_H / 8)
#define I2C_TIMEOUT   100

static const char *TAG = "OLED";
static i2c_master_dev_handle_t oled_dev = NULL;
static bool oled_present = false;
static bool oled_on = true;
static uint8_t fb[SSD1306_W * SSD1306_PAGES];

// 6x8 font, ASCII 32-126.  Each glyph is 6 columns, LSB = top pixel.
static const uint8_t font[][6] = {
    {0x00,0x00,0x00,0x00,0x00,0x00}, // 32 space
    {0x00,0x00,0x5F,0x00,0x00,0x00}, // 33 !
    {0x00,0x07,0x00,0x07,0x00,0x00}, // 34 "
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    {0x08,0x08,0x2A,0x1C,0x08,0x00}, // 126 ~
};

static esp_err_t oled_cmd(uint8_t cmd)
{
    uint8_t buf[2] = {0x00, cmd};
    return i2c_master_transmit(oled_dev, buf, 2, I2C_TIMEOUT);
}

static esp_err_t oled_cmds(const uint8_t *cmds, size_t len)
{
    for (size_t i = 0; i < len; i++) {
        esp_err_t ret = oled_cmd(cmds[i]);
        if (ret != ESP_OK) return ret;
    }
    return ESP_OK;
}

static esp_err_t oled_send_fb(void)
{
    static const uint8_t setup[] = {
        0x21, 0x00, 0x7F,               // column range 0-127
        0x22, 0x00, SSD1306_PAGES - 1,  // page range 0-3
    };
    esp_err_t ret = oled_cmds(setup, sizeof(setup));
    if (ret != ESP_OK) return ret;

    // Send framebuffer with 0x40 control prefix
    uint8_t buf[1 + sizeof(fb)];
    buf[0] = 0x40;
    memcpy(buf + 1, fb, sizeof(fb));
    return i2c_master_transmit(oled_dev, buf, sizeof(buf), I2C_TIMEOUT);
}

bool display_is_present(void)
{
    return oled_present;
}

void display_set_power(bool on)
{
    if (!oled_present || oled_on == on) return;
    oled_on = on;
    if (on) {
        oled_cmd(0xAF);   // display on
        oled_send_fb();   // push current readings now that panel is visible
    } else {
        oled_cmd(0xAE);   // display off
    }
    ESP_LOGI(TAG, "display %s", on ? "on" : "off");
}

void display_set_brightness(uint8_t level)
{
    if (!oled_present) return;
    uint8_t cmd[2] = {0x81, level};
    oled_cmds(cmd, sizeof(cmd));
    ESP_LOGI(TAG, "brightness=%u", level);
}

static void fb_clear(void)
{
    memset(fb, 0, sizeof(fb));
}

static void fb_putchar(int x, int page, char c)
{
    if (c < 32 || c > 126) c = ' ';
    int idx = c - 32;
    for (int col = 0; col < 6 && (x + col) < SSD1306_W; col++)
        fb[page * SSD1306_W + x + col] = font[idx][col];
}

static void fb_puts(int x, int page, const char *s)
{
    while (*s && x < SSD1306_W) {
        fb_putchar(x, page, *s++);
        x += 6;
    }
}

// Double-height rendering: stretches a 6x8 glyph across two pages
static void fb_putchar_2x(int x, int page, char c)
{
    if (c < 32 || c > 126) c = ' ';
    int idx = c - 32;
    for (int col = 0; col < 12 && (x + col) < SSD1306_W; col++) {
        uint8_t src = font[idx][col / 2];
        uint8_t lo = 0, hi = 0;
        for (int bit = 0; bit < 4; bit++) {
            if (src & (1 << bit)) lo |= (3 << (bit * 2));
        }
        for (int bit = 0; bit < 4; bit++) {
            if (src & (1 << (bit + 4))) hi |= (3 << (bit * 2));
        }
        fb[page * SSD1306_W + x + col] = lo;
        fb[(page + 1) * SSD1306_W + x + col] = hi;
    }
}

static void fb_puts_2x(int x, int page, const char *s)
{
    while (*s && x < SSD1306_W) {
        fb_putchar_2x(x, page, *s++);
        x += 12;
    }
}

bool display_init(i2c_master_bus_handle_t bus)
{
    if (i2c_master_probe(bus, SSD1306_ADDR, I2C_TIMEOUT) != ESP_OK) {
        ESP_LOGI(TAG, "No SSD1306 at 0x%02X — display disabled", SSD1306_ADDR);
        return false;
    }

    i2c_device_config_t cfg = {
        .dev_addr_length = I2C_ADDR_BIT_LEN_7,
        .device_address  = SSD1306_ADDR,
        .scl_speed_hz    = 400000,
    };
    if (i2c_master_bus_add_device(bus, &cfg, &oled_dev) != ESP_OK) {
        ESP_LOGE(TAG, "Failed to add SSD1306 device");
        return false;
    }

    static const uint8_t init_seq[] = {
        0xAE,       // display off
        0xD5, 0x80, // clock div
        0xA8, 0x1F, // mux ratio 32
        0xD3, 0x00, // display offset 0
        0x40,       // start line 0
        0x8D, 0x14, // charge pump on
        0x20, 0x00, // horizontal addressing mode
        0xA1,       // segment remap
        0xC8,       // COM scan decrement
        0xDA, 0x02, // COM pins config (sequential, for 128x32)
        0x81, 0x8F, // contrast
        0xD9, 0xF1, // precharge
        0xDB, 0x40, // VCOMH deselect
        0xA4,       // display from RAM
        0xA6,       // normal (not inverted)
        0xAF,       // display on
    };
    if (oled_cmds(init_seq, sizeof(init_seq)) != ESP_OK) {
        ESP_LOGE(TAG, "SSD1306 init sequence failed");
        return false;
    }

    fb_clear();
    oled_send_fb();
    oled_present = true;
    ESP_LOGI(TAG, "SSD1306 128x64 OLED ready");
    return true;
}

void display_update(uint16_t co2_ppm, float temp_c, float rh_pct)
{
    if (!oled_present) return;

    fb_clear();

    char buf[22];

    // Pages 0-1: CO2 value in double-height
    snprintf(buf, sizeof(buf), "%u", co2_ppm);
    fb_puts_2x(0, 0, buf);
    int num_w = (int)strlen(buf) * 12 + 4;
    fb_puts(num_w, 1, "ppm");

    // Page 3: temperature and humidity in normal text
    snprintf(buf, sizeof(buf), "%.1f C", temp_c);
    fb_puts(0, 3, buf);

    snprintf(buf, sizeof(buf), "%.1f %%", rh_pct);
    fb_puts(66, 3, buf);

    // Always keep fb fresh, but skip the I2C burst while panel is off — it'll
    // get pushed on the next display_set_power(true).
    if (oled_on) oled_send_fb();
}
